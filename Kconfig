## Kconfig
```kconfig
config SPEECHMIND_EN_MENU
    bool "Enable SpeechMind"
    default n
    select SPEECHMIND_EN if WHC_HOST || WHC_NONE
    select AUDIO_FWK if WHC_HOST || WHC_NONE
    select AUDIO_MIXER if WHC_HOST || WHC_NONE
    select MEDIA_PLAYER if WHC_HOST || WHC_NONE
    select MEDIA_DEMUX_WAV if WHC_HOST || WHC_NONE
    select MEDIA_DEMUX_MP3 if WHC_HOST || WHC_NONE
    select MEDIA_CODEC_PCM if WHC_HOST || WHC_NONE
    select MEDIA_CODEC_MP3 if WHC_HOST || WHC_NONE
    select IMQ_EN if AMEBALITE && (WHC_HOST || WHC_NONE)
    select RPC_EN if AMEBALITE && (WHC_HOST || WHC_NONE)

config SPEECHMIND_EN
    bool
```
